// E15 — Node D: On-device Autoencoder Anomaly Detector
//
// Runs a 5→8→4→8→5 autoencoder (manual inference, no TFLite dependency)
// using pre-trained weights from autoencoder_weights.h.
//
// Feature vector per observed Hello packet:
//   [rssi_norm, hop_count_norm, mv_delta_norm, interval_norm, local_pdr]
//
// Reconstruction error > AE_THRESHOLD → anomaly alert
//
// Normalization bounds:
//   rssi:      [-120, -30] dBm
//   hop_count: [1, 6]
//   mv_delta:  [0, 10]
//   interval:  [5, 30] seconds
//   local_pdr: [0, 1]
//
// Performance target (ESP32-S3 @ 240MHz):
//   Inference: < 1ms  (169 params, pure float32 SIMD)
//   RAM:       676 bytes weights + ~200 bytes stack = < 1KB total overhead
//
// Board: Ebyte EoRa PI (ESP32-S3FH4R2)  FQBN: esp32:esp32:esp32s3:CDCOnBoot=cdc
// Reference: extends springer2026-blockchain-ids (SecuMesh-Net) to ESP32-S3 hardware

#define NODE_ID        0xDD
#define AE_THRESHOLD   0.015424f   // set from train_autoencoder.py output

// Structs before includes to avoid Arduino auto-prototype ordering bug
#define HMAC_TAG_LEN  16
#define MSG_HELLO     0x01
#define MSG_DATA      0x02

struct HelloMsg {
  uint8_t  type;
  uint8_t  src;
  uint8_t  dst_gw;
  uint8_t  metric;
  uint16_t seq;
  uint8_t  hmac[HMAC_TAG_LEN];
} __attribute__((packed));

struct NodeStat {
  uint8_t  addr;
  bool     valid;
  uint32_t last_hello_ms;
  uint16_t last_seq;
  uint32_t pkt_recv_5min;
  uint32_t pkt_expected_5min;
  uint32_t window_start_ms;
};

#include "autoencoder_weights.h"   // generated by train_autoencoder.py

#include <RadioLib.h>
#include <SPI.h>
#include "mbedtls/md.h"
#include <Wire.h>
#include "SSD1306Wire.h"

// Radio pins (EoRa PI)
#define LORA_NSS    7
#define LORA_DIO1  33
#define LORA_RST    8
#define LORA_BUSY  34
#define LORA_SCK    5
#define LORA_MOSI   6
#define LORA_MISO   3

#define LORA_FREQ   923.0
#define LORA_BW     125.0
#define LORA_SF     9
#define LORA_CR     7
#define LORA_SYNC   0x34
#define LORA_POWER  10
#define LORA_TCXO   1.6f

inline void eora_radio_init() {
  pinMode(LORA_NSS,  OUTPUT); digitalWrite(LORA_NSS,  HIGH);
  pinMode(LORA_BUSY, INPUT);
  pinMode(LORA_RST,  OUTPUT);
  digitalWrite(LORA_RST, LOW);  delay(2);
  digitalWrite(LORA_RST, HIGH); delay(20);
  uint32_t t = millis();
  while (digitalRead(LORA_BUSY) && millis() - t < 500) delay(1);
}

#define MAX_TRACKED  8
NodeStat node_stats[MAX_TRACKED];

NodeStat* get_stat(uint8_t addr) {
  for (int i = 0; i < MAX_TRACKED; i++) {
    if (node_stats[i].valid && node_stats[i].addr == addr) return &node_stats[i];
  }
  for (int i = 0; i < MAX_TRACKED; i++) {
    if (!node_stats[i].valid) {
      node_stats[i] = {addr, true, 0, 0, 0, 0, millis()};
      return &node_stats[i];
    }
  }
  return nullptr;
}

// --- Autoencoder inference (manual, no TFLite) ---
static inline float relu(float x) { return x > 0 ? x : 0; }

float ae_infer(const float *input, float *recon_out) {
  float h1[AE_HIDDEN1], h2[AE_LATENT], h3[AE_HIDDEN2], h4[AE_OUTPUT_DIM];

  // Layer 1: 5 → 8 (ReLU)
  for (int j = 0; j < AE_HIDDEN1; j++) {
    float s = ae_b1[j];
    for (int i = 0; i < AE_INPUT_DIM; i++) s += input[i] * ae_W1[i * AE_HIDDEN1 + j];
    h1[j] = relu(s);
  }
  // Layer 2: 8 → 4 (ReLU)
  for (int j = 0; j < AE_LATENT; j++) {
    float s = ae_b2[j];
    for (int i = 0; i < AE_HIDDEN1; i++) s += h1[i] * ae_W2[i * AE_LATENT + j];
    h2[j] = relu(s);
  }
  // Layer 3: 4 → 8 (ReLU)
  for (int j = 0; j < AE_HIDDEN2; j++) {
    float s = ae_b3[j];
    for (int i = 0; i < AE_LATENT; i++) s += h2[i] * ae_W3[i * AE_HIDDEN2 + j];
    h3[j] = relu(s);
  }
  // Layer 4: 8 → 5 (Linear)
  for (int j = 0; j < AE_OUTPUT_DIM; j++) {
    float s = ae_b4[j];
    for (int i = 0; i < AE_HIDDEN2; i++) s += h3[i] * ae_W4[i * AE_OUTPUT_DIM + j];
    h4[j] = s;
    if (recon_out) recon_out[j] = h4[j];
  }

  // Reconstruction MSE
  float mse = 0;
  for (int i = 0; i < AE_OUTPUT_DIM; i++) {
    float diff = h4[i] - input[i];
    mse += diff * diff;
  }
  return mse / AE_OUTPUT_DIM;
}

float normalize_feature(float val, float lo, float hi) {
  float n = (val - lo) / (hi - lo + 1e-9f);
  return n < 0 ? 0 : (n > 1 ? 1 : n);
}

// --- State ---
uint32_t total_heard   = 0;
uint32_t ae_alerts     = 0;
uint32_t last_oled     = 0;
float    last_mse      = 0;

SSD1306Wire oled(0x3c, 18, 17);
SPIClass    spi(FSPI);
Module*     mod   = nullptr;
SX1262*     radio = nullptr;

volatile bool rxFlag = false;
void IRAM_ATTR onDio1() { rxFlag = true; }

void oled_draw() {
  oled.clear();
  oled.setFont(ArialMT_Plain_10);
  oled.setTextAlignment(TEXT_ALIGN_LEFT);
  oled.drawString(0,  0, "NODE D  AE IDS");
  char buf[32];
  snprintf(buf, sizeof(buf), "heard=%lu alrt=%lu", total_heard, ae_alerts);
  oled.drawString(0, 14, buf);
  snprintf(buf, sizeof(buf), "MSE=%.5f thr=%.4f", last_mse, AE_THRESHOLD);
  oled.drawString(0, 28, buf);
  oled.drawString(0, 42, ae_alerts > 0 ? "ANOMALY DETECTED" : "normal");
  oled.display();
}

void process_hello(const HelloMsg *h, float rssi) {
  NodeStat *s = get_stat(h->src);
  if (!s) return;

  uint32_t now = millis();
  float interval_s = s->last_hello_ms > 0
    ? (now - s->last_hello_ms) / 1000.0f : 10.0f;
  float mv_delta   = s->last_hello_ms > 0
    ? (float)abs((int16_t)(h->seq - s->last_seq)) : 1.0f;
  float hop_count  = (float)(h->metric + 1);

  // PDR estimate over 5-minute window
  if (now - s->window_start_ms > 300000UL) {
    s->pkt_recv_5min = s->pkt_expected_5min = 0;
    s->window_start_ms = now;
  }
  s->pkt_expected_5min++;
  s->pkt_recv_5min++;  // Hello itself counts as received
  float local_pdr = s->pkt_expected_5min > 0
    ? (float)s->pkt_recv_5min / s->pkt_expected_5min : 1.0f;

  // Build normalized feature vector
  float feat[AE_INPUT_DIM];
  feat[0] = normalize_feature(rssi,       -120.0f, -30.0f);
  feat[1] = normalize_feature(hop_count,    1.0f,    6.0f);
  feat[2] = normalize_feature(mv_delta,     0.0f,   10.0f);
  feat[3] = normalize_feature(interval_s,   5.0f,   30.0f);
  feat[4] = normalize_feature(local_pdr,    0.0f,    1.0f);

  // Inference
  uint32_t t0  = micros();
  float    mse = ae_infer(feat, nullptr);
  uint32_t us  = micros() - t0;

  last_mse = mse;
  total_heard++;

  Serial.printf("[AE] src=0x%02X rssi=%.1f hop=%d interval=%.1fs mv_delta=%.0f pdr=%.2f"
                " MSE=%.6f thr=%.6f inf=%luus\n",
                h->src, rssi, (int)hop_count, interval_s, mv_delta, local_pdr,
                mse, AE_THRESHOLD, us);

  if (mse > AE_THRESHOLD) {
    ae_alerts++;
    Serial.printf("[AE] ANOMALY src=0x%02X MSE=%.6f > %.6f (alerts=%lu)\n",
                  h->src, mse, AE_THRESHOLD, ae_alerts);
    oled_draw();
  }

  s->last_hello_ms = now;
  s->last_seq      = h->seq;
}

void setup() {
  Serial.begin(115200);
  delay(500);
  Serial.println("\n=== E15 Node D (Autoencoder IDS) ===");
  Serial.printf("[INFO] Architecture: %d→%d→%d→%d→%d  params=%d  threshold=%.6f\n",
                AE_INPUT_DIM, AE_HIDDEN1, AE_LATENT, AE_HIDDEN2, AE_OUTPUT_DIM,
                (AE_INPUT_DIM*AE_HIDDEN1 + AE_HIDDEN1 +
                 AE_HIDDEN1*AE_LATENT   + AE_LATENT  +
                 AE_LATENT*AE_HIDDEN2   + AE_HIDDEN2 +
                 AE_HIDDEN2*AE_OUTPUT_DIM + AE_OUTPUT_DIM),
                AE_THRESHOLD);
  Serial.println("[INFO] Inference timing printed per Hello — target <1ms on ESP32-S3.");
  memset(node_stats, 0, sizeof(node_stats));

  Wire.begin(18, 17);
  oled.init(); oled.flipScreenVertically();
  oled_draw();

  eora_radio_init();
  spi.begin(LORA_SCK, LORA_MISO, LORA_MOSI, LORA_NSS);
  mod   = new Module(LORA_NSS, LORA_DIO1, LORA_RST, LORA_BUSY, spi);
  radio = new SX1262(mod);
  int st = radio->begin(LORA_FREQ, LORA_BW, LORA_SF, LORA_CR,
                        LORA_SYNC, LORA_POWER, 8, LORA_TCXO);
  if (st != RADIOLIB_ERR_NONE) {
    Serial.printf("[ERR] Radio init: %d\n", st); while (true) delay(1000);
  }
  radio->setDio1Action(onDio1);
  radio->startReceive();
  Serial.println("[RADIO] SX1262 ready — autoencoder inference active");
}

void loop() {
  if (millis() - last_oled >= 5000) { last_oled = millis(); oled_draw(); }

  if (rxFlag) {
    rxFlag = false;
    uint8_t buf[256];
    size_t  pkt_len = radio->getPacketLength();
    float   rssi    = radio->getRSSI();
    int     state   = radio->readData(buf, sizeof(buf));
    radio->startReceive();
    if (state != RADIOLIB_ERR_NONE || pkt_len == 0) return;

    if (buf[0] == MSG_HELLO && pkt_len >= sizeof(HelloMsg)) {
      process_hello((HelloMsg*)buf, rssi);
    }
  }
}
